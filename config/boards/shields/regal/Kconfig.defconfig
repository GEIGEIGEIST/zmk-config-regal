## config/boards/shields/regal/Kconfig.defconfig
```kconfig
    # Copyright (c) 2022 The ZMK Contributors
# SPDX-License-Identifier: MIT

if SHIELD_REGAL

config ZMK_KEYBOARD_NAME
    default "REGAL"

endif # SHIELD_REGAL
```

## config/boards/shields/regal/Kconfig.shield
```kconfig
# Copyright (c) 2022 The ZMK Contributors
# SPDX-License-Identifier: MIT

config SHIELD_REGAL
    def_bool $(shields_list_contains,regal)
```
